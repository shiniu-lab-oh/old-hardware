## apps/pb-runtime/main/Kconfig.projbuild
```kconfig
menu "PB Runtime"

config PB_PANEL_PROFILE
    string "Old Panel hardware profile"
    default "LP-001"

config PB_WIFI_SSID
    string "Wi-Fi SSID"
    default ""

config PB_WIFI_PASSWORD
    string "Wi-Fi password"
    default ""

config PB_CLOUD_BASE_URL
    string "PB Cloud base URL"
    default ""
    help
        Origin only, without a trailing slash. Example: https://erp.example.com

config PB_DEVICE_SERIAL
    string "PB device serial number"
    default ""

config PB_DEVICE_TOKEN
    string "PB device token"
    default ""

config PB_SNTP_SERVER
    string "SNTP server for event timestamps"
    default "pool.ntp.org"
    help
        Event timestamps are optional until the first successful time sync.
        The Cloud falls back to its receive time when no timestamp is available.

config PB_PRIMARY_KEY_INDEX
    int "Physical key mapped to the primary action"
    range 1 8
    default 6
    help
        One-based physical key index. The runtime emits only the generic
        primary action; the active PB App decides what that action means.

config PB_PRIMARY_LONG_PRESS_MS
    int "Primary long press threshold in milliseconds"
    range 500 5000
    default 1750

config PB_BOOT_OVERLAY_MS
    int "Boot overlay duration in milliseconds"
    range 250 5000
    default 800

config PB_OFFLINE_OVERLAY_MS
    int "Offline overlay duration in milliseconds"
    range 250 5000
    default 1500

config PB_POLL_INTERVAL_SECONDS
    int "State polling interval in seconds"
    range 2 3600
    default 10

config PB_HTTP_TIMEOUT_MS
    int "HTTP request timeout in milliseconds"
    range 1000 60000
    default 5000

endmenu
```

## apps/pb-runtime/sdkconfig.defaults
```kconfig
CONFIG_MBEDTLS_CERTIFICATE_BUNDLE=y
CONFIG_PB_PANEL_PROFILE="LP-001"
CONFIG_PB_DEVICE_SERIAL=""
CONFIG_PB_SNTP_SERVER="pool.ntp.org"
CONFIG_PB_PRIMARY_KEY_INDEX=6
CONFIG_PB_PRIMARY_LONG_PRESS_MS=1750
CONFIG_PB_BOOT_OVERLAY_MS=800
CONFIG_PB_OFFLINE_OVERLAY_MS=1500
CONFIG_PB_POLL_INTERVAL_SECONDS=10
CONFIG_PB_HTTP_TIMEOUT_MS=5000
CONFIG_COMPILER_OPTIMIZATION_SIZE=y
# CONFIG_COMPILER_OPTIMIZATION_DEBUG is not set
```
